## config/west.yml
```yaml
manifest:
  remotes:
    - name: infused-kim
      url-base: https://github.com/infused-kim
  projects:
    - name: zmk-zephyr
      remote: infused-kim
      revision: v2.5.0+zmk-fixes+kim-fixes
  self:
    path: config
```
